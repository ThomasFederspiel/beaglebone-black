/*
 * Copyright (C) 2013 CircuitCo
 * Copyright (C) 2013 Texas Instruments
 *
 * This program is free software; you can redistribute it and/or modify
 * it under the terms of the GNU General Public License version 2 as
 * published by the Free Software Foundation.
 *
 * This is a template-generated file from BoneScript
 */
/dts-v1/;
/plugin/;

/ {
	compatible = "ti,beaglebone", "ti,beaglebone-black";

	/* identification */
	part-number = "BS_PWM_PRUSS";
	version = "00A0";

	/* state the resources this cape uses */
	exclusive-use =
		/* the pin header uses */
		"P9.31",
		"P9.29",
		/* the hardware IP uses */
		"ehrpwm0A",
		"ehrpwm0B";

	fragment@0 {
		target = <&am33xx_pinmux>;
		__overlay__ {
			bs_pwm_P9_31_0x31: pinmux_bs_pwm_P9_31_0x31 {
				pinctrl-single,pins = <0x190 0x31>;
			bs_pwm_P9_29_0x31: pinmux_bs_pwm_P9_29_0x31 {
				pinctrl-single,pins = <0x194 0x31>;
			};
		};
	};

	fragment@1 {
		target = <&ocp>;
		__overlay__ {
			bs_pwm_test_P9_31 {
				compatible	= "pwm_test";
				pwms 		= <&ehrpwm0 0 500000 1>;
				pwm-names 	= "PWM_P9_31";
				pinctrl-names	= "default";
				pinctrl-0	= <&bs_pwm_P9_31_0x31>;
				enabled		= <1>;
				duty		= <0>;
				status 		= "okay";
			};
			bs_pwm_test_P9_29 {
				compatible	= "pwm_test";
				pwms 		= <&ehrpwm0 1 500000 1>;
				pwm-names 	= "PWM_P9_29";
				pinctrl-names	= "default";
				pinctrl-0	= <&bs_pwm_P9_29_0x31>;
				enabled		= <1>;
				duty		= <0>;
				status 		= "okay";
			};
		};
	};
};
	
};
